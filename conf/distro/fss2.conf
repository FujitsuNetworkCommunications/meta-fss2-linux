## conf/distro/fss2.conf
```bitbake
require conf/distro/poky.conf
DISTRO = "fss2"
DISTRO_NAME = "FSS2 Linux"
DISTRO_VERSION = "1.0_0"

SDK_VENDOR = "-fss2sdk"
SDK_VERSION := "${@'${DISTRO_VERSION}'.replace('snapshot-${DATE}','snapshot')}"

MAINTAINER = "Fujitsu <Dan.Berger@us.fujitsu.com>"

TARGET_VENDOR = "-fss2"

SANITY_TESTED_DISTROS += "\
    Ubuntu-12.10 \n \
    OracleServer-7.4 \n \
    OracleServer-7.5 \n \
    ol-7.5 \n \
    CentOS-Linux-7.2.1511 \n \
    CentOS-Linux-7.5.1804 \n \
    "

DISTRO_FEATURES = "ptest argp ext2 largefile xattr nfs pci multiarch ${DISTRO_FEATURES_LIBC} "
BB_DANGLINGAPPENDS_WARNONLY ?= "1"
```

## conf/layer.conf
```bitbake
# We have a conf and classes directory, add to BBPATH
BBPATH .= ":${LAYERDIR}"

# We have recipes-* directories, add to BBFILES
BBFILES += "${LAYERDIR}/recipes-*/*/*.bb"
BBFILES += "${LAYERDIR}/recipes-*/*/*.bbappend"

BBFILE_COLLECTIONS += "fss2-linux"
BBFILE_PATTERN_fss2-linux = "^${LAYERDIR}/"
BBFILE_PRIORITY_fss2-linux = "6"

PYRO_BBMASK += "meta-fnc-platform/recipes-core/util-linux/"
PYRO_BBMASK += "meta-fnc-platform/recipes-devtools/gdb/"
PYRO_BBMASK += "meta-fnc-platform/recipes-support/gmp/"
PYRO_BBMASK += "meta-fnc-platform/recipes-test/gtest/"

PYRO_BBMASK += "meta-fnc-platform/recipes-support/c-ares/c-ares_1.1.2.0.bb"

BBMASK += "${@bb.utils.contains('DISTRO_CODENAME', 'daisy', "", "${PYRO_BBMASK}", d)}"

HOSTTOOLS += "sdl-config"

REQUIRED_POKY_BBLAYERS_CONF_VERSION = "2"
```
